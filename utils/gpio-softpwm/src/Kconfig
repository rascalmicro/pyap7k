## utils/gpio-softpwm/src/Kconfig
```kconfig
config GPIO_SOFTPWM
	tristate "PWM on GPIO"
	depends on GENERIC_GPIO
	help
	  This driver adds support for PWM Signal output on GPIO lines.

	  This support is also available as a module.  If so, the module
	  will be called gpio-softpwm.
```
